# file: test.ioc
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Mcu.Family=STM32F1
Mcu.Name=STM32F105R(8-B-C)Tx
Mcu.Package=LQFP64
NVIC.PriorityGroup=NVIC_PRIORITYGROUP_4
ProjectManager.HeapSize=0x200
ProjectManager.StackSize=0x400
ProjectManager.TargetToolchain=STM32CubeIDE
RCC.USBFreq_Value=10666666.666666666
VP_SYS_VS_ND.Mode=No_Debug
board=custom

// file: Core/Src/main.c
/* USER CODE BEGIN Header */
/**
  ******************************************************************************
  * @file           : main.c
  * @brief          : Main program body
  ******************************************************************************
  * @attention
  *
  * <h2><center>&copy; Copyright (c) 2020 STMicroelectronics.
  * All rights reserved.</center></h2>
  *
  * This software component is licensed by ST under BSD 3-Clause license,
  * the "License"; You may not use this file except in compliance with the
  * License. You may obtain a copy of the License at:
  *                        opensource.org/licenses/BSD-3-Clause
  *
  ******************************************************************************
  */
/* USER CODE END Header */

#include "main.h"

/* USER CODE BEGIN Includes */
uint16_t __attribute__((section("FM_ARRAY_MEMORY_SECTION"))) array1[200] =
{
  0x31C7, 0x1C71, 0x31C7, 0x1C6F,
  0x31C7, 0x1C6A, 0x31C7, 0x1C6B,
  0x31C7, 0x193E, 0x31C7, 0x1CB4,
  0x31C7, 0x1C71, 0x31C7, 0x1C6F,
    0x31C7, 0x1C6A, 0x31C7, 0x1C6B,
    0x31C7, 0x193E, 0x31C7, 0x1CB4,
	0x31C7, 0x1C71, 0x31C7, 0x1C6F,
	  0x31C7, 0x1C6A, 0x31C7, 0x1C6B,
	  0x31C7, 0x193E, 0x31C7, 0x1CB4,
	  0x31C7, 0x1C71, 0x31C7, 0x1C6F,
	    0x31C7, 0x1C6A, 0x31C7, 0x1C6B,
	    0x31C7, 0x193E, 0x31C7, 0x1CB4,
		0x31C7, 0x1C71, 0x31C7, 0x1C6F,
		  0x31C7, 0x1C6A, 0x31C7, 0x1C6B,
		  0x31C7, 0x193E, 0x31C7, 0x1CB4
};
/* USER CODE END Includes */

void SystemClock_Config(void);

int main(void)
{

  /* MCU Configuration--------------------------------------------------------*/

  /* Reset of all peripherals, Initializes the Flash interface and the Systick. */
  HAL_Init();

  /* Configure the system clock */
  SystemClock_Config();

  /* Initialize all configured peripherals */
  /* USER CODE BEGIN 2 */
int i=0;
  /* USER CODE END 2 */

  /* Infinite loop */
  while (1)
  {
	  printf("%d",array1[i++]);
	  array1[i++]=i;
  }
}

void SystemClock_Config(void)
{
  RCC_OscInitTypeDef RCC_OscInitStruct = {0};
  RCC_ClkInitTypeDef RCC_ClkInitStruct = {0};

  /** Initializes the CPU, AHB and APB busses clocks
  */
  RCC_OscInitStruct.OscillatorType = RCC_OSCILLATORTYPE_HSI;
  RCC_OscInitStruct.HSIState = RCC_HSI_ON;
  RCC_OscInitStruct.HSICalibrationValue = RCC_HSICALIBRATION_DEFAULT;
  RCC_OscInitStruct.PLL.PLLState = RCC_PLL_NONE;
  RCC_OscInitStruct.PLL2.PLL2State = RCC_PLL_NONE;
  if (HAL_RCC_OscConfig(&RCC_OscInitStruct) != HAL_OK)
  {
    Error_Handler();
  }
  /** Initializes the CPU, AHB and APB busses clocks
  */
  RCC_ClkInitStruct.ClockType = RCC_CLOCKTYPE_HCLK|RCC_CLOCKTYPE_SYSCLK
                              |RCC_CLOCKTYPE_PCLK1|RCC_CLOCKTYPE_PCLK2;
  RCC_ClkInitStruct.SYSCLKSource = RCC_SYSCLKSOURCE_HSI;
  RCC_ClkInitStruct.AHBCLKDivider = RCC_SYSCLK_DIV1;
  RCC_ClkInitStruct.APB1CLKDivider = RCC_HCLK_DIV1;
  RCC_ClkInitStruct.APB2CLKDivider = RCC_HCLK_DIV1;

  if (HAL_RCC_ClockConfig(&RCC_ClkInitStruct, FLASH_LATENCY_0) != HAL_OK)
  {
    Error_Handler();
  }
  /** Configure the Systick interrupt time
  */
  __HAL_RCC_PLLI2S_ENABLE();
}

void Error_Handler(void)
{
}

/************************ (C) COPYRIGHT STMicroelectronics *****END OF FILE****/
